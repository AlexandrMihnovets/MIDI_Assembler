/*
 * port_ini.inc
 *
 *  Created: 23.12.2021 16:47:30
 *   Author: MikhnovetsA
 */ 

 ; Настройка портов
				
				; Управление адресами мультиплексоров
				ldi		r16, (1 << PD4) | (1 << PD3) | (1 << PD2) | (1 << PD1)			; 
				out		DDRD, r16														; Настроил пины 1-4 порта D на выход для адресации мультиплексоров
				andi	r16, ~((1 << PD4) | (1 << PD3) | (1 << PD2) | (1 << PD1))		;
				out		PORTD, r16														; Начальное состояние - ноль

				; Выходы мультиплексоров
				andi	r16, ~((1 << PC3) | (1 << PC2) | (1 << PC1) | (1 << PC0))		;
				out		DDRC, r16														; Пины 0-3 порта С настроены на вход для правой клавиатуры
				andi	r16, ~((1 << PB1) | (1 << PB0))									;
				out		DDRB, r16														; Пины 0 и 1 порта В для левой клавиатуры

				; Кнопки, подключенные напрямую
				andi	r16, ~((1 << PB5) | (1 << PB4) | (1 << PB3) | (1 << PB2))		; 
				out		DDRB, r16														; Пины 2-5 порта B на вход для 4-х кнопок (на PB2 от энкодера)

				; Энкодер	
				andi	r16, ~((1 << PD7) | (1 << PD6))									; 
				out		DDRD, r16														; Пины 6 и 7 порта D на вход для энкодера

				